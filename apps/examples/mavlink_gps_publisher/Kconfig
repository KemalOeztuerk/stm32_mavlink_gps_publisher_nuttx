## apps/examples/mavlink_gps_publisher/Kconfig
```kconfig
#
# For a description of the syntax of this configuration file,
# see the file kconfig-language.txt in the NuttX tools repository.
#

config EXAMPLES_MAVLINK_GPS_PUBLISHER
	tristate "MAVLink GPS/IMU publisher example"
	default n
	depends on SERIAL_TERMIOS && CANUTILS_LIBDRONECAN
	---help---
		Enable the MAVLink GPS/IMU publisher example. Reads every sensor a
		Here4 broadcasts over DroneCAN (GNSS Fix2/Auxiliary, magnetometer,
		raw IMU, barometer), runs a complementary-filter AHRS, serves
		dynamic node ID allocation so the Here4 needs no static node ID,
		and streams MAVLink telemetry (HEARTBEAT, GPS_INPUT, GPS_RAW_INT,
		GLOBAL_POSITION_INT, HIGHRES_IMU, SCALED_PRESSURE, ATTITUDE,
		VFR_HUD, FOLLOW_TARGET) out a serial port at 10Hz.

if EXAMPLES_MAVLINK_GPS_PUBLISHER

config EXAMPLES_MAVLINK_GPS_PUBLISHER_PROGNAME
	string "Program name"
	default "mavlink_gps_publisher"
	---help---
		This is the name of the program that will be used when the NSH ELF
		program is installed.

config EXAMPLES_MAVLINK_GPS_PUBLISHER_PRIORITY
	int "mavlink_gps_publisher task priority"
	default 100

config EXAMPLES_MAVLINK_GPS_PUBLISHER_STACKSIZE
	int "mavlink_gps_publisher stack size"
	default DEFAULT_TASK_STACKSIZE

config EXAMPLES_MAVLINK_GPS_PUBLISHER_MAVLINK_DEVPATH
	string "MAVLink UART device path"
	default "/dev/ttyS0"
	---help---
		Serial device the MAVLink telemetry link (companion/autopilot) is
		attached to.

config EXAMPLES_MAVLINK_GPS_PUBLISHER_CAN_DEVPATH
	string "Here4/DroneCAN CAN device path"
	default "/dev/can0"
	---help---
		CAN device the Here4 GNSS/compass/IMU/baro is attached to.

config EXAMPLES_MAVLINK_GPS_PUBLISHER_DRONECAN_NODE_ID
	int "DroneCAN local node ID"
	default 127
	range 1 127
	---help---
		Our own node ID on the DroneCAN bus. This node transmits (NodeStatus
		and dynamic-node-ID allocation responses), so it must not collide
		with any other node. IDs handed out to allocatees stay at or below
		125, so the default of 127 can never conflict with them.

config EXAMPLES_MAVLINK_GPS_PUBLISHER_DRONECAN_MEM_POOL_SIZE
	int "DroneCAN node memory pool size"
	default 1024
	---help---
		Memory pool size (bytes) for libcanard's transfer reassembly and
		TX queue allocator.

endif
```
